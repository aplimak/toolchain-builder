## Config.in
```kconfig
source "$BR2_EXTERNAL_AELIUX_EXTERNAL_PATH/package/ghostty-terminfo/Config.in"
source "$BR2_EXTERNAL_AELIUX_EXTERNAL_PATH/package/enter/Config.in"
source "$BR2_EXTERNAL_AELIUX_EXTERNAL_PATH/package/musl-utils/Config.in"
```

## configs/g610_defconfig
```kconfig
BR2_arm=y
BR2_cortex_a7=y
BR2_ARM_FPU_NEON_VFPV4=y
BR2_TOOLCHAIN_BUILDROOT_VENDOR="g610"
BR2_TOOLCHAIN_BUILDROOT_MUSL=y
BR2_KERNEL_HEADERS_VERSION=y
BR2_DEFAULT_KERNEL_VERSION="3.4.113"
BR2_PACKAGE_HOST_LINUX_HEADERS_CUSTOM_3_4=y
BR2_BINUTILS_VERSION_2_47_X=y
BR2_GCC_VERSION_16_X=y
BR2_TOOLCHAIN_BUILDROOT_CXX=y
BR2_TOOLCHAIN_BUILDROOT_FORTRAN=y
BR2_GCC_ENABLE_OPENMP=y
BR2_GCC_ENABLE_GRAPHITE=y
BR2_PACKAGE_HOST_GDB=y
BR2_PACKAGE_HOST_GDB_TUI=y
BR2_PACKAGE_HOST_GDB_PYTHON3=y
BR2_PACKAGE_HOST_GDB_LZMA=y
BR2_GDB_VERSION_17=y
BR2_DL_DIR="$(BR2_EXTERNAL_AELIUX_EXTERNAL_PATH)/dl"
BR2_ENABLE_DEBUG=y
BR2_OPTIMIZE_3=y
BR2_PACKAGE_OVERRIDE_FILE="$(BR2_EXTERNAL_AELIUX_EXTERNAL_PATH)/local.mk"
BR2_GLOBAL_PATCH_DIR="$(BR2_EXTERNAL_AELIUX_EXTERNAL_PATH)/patches"
BR2_ROOTFS_DEVICE_CREATION_STATIC=y
BR2_ROOTFS_MERGED_USR=y
BR2_TARGET_GENERIC_ROOT_PASSWD="root"
BR2_SYSTEM_BIN_SH_BASH=y
BR2_SYSTEM_DEFAULT_PATH="/bin:/sbin:/usr/bin:/usr/sbin"
BR2_ROOTFS_OVERLAY="$(BR2_EXTERNAL_AELIUX_EXTERNAL_PATH)/boards/common/overlay"
BR2_ROOTFS_POST_FAKEROOT_SCRIPT="$(BR2_EXTERNAL_AELIUX_EXTERNAL_PATH)/boards/common/post-fakeroot.sh"
BR2_PACKAGE_FFMPEG=y
BR2_PACKAGE_FFMPEG_GPL=y
BR2_PACKAGE_FFMPEG_FFPROBE=y
BR2_PACKAGE_BROTLI=y
BR2_PACKAGE_GZIP=y
BR2_PACKAGE_LRZIP=y
BR2_PACKAGE_LZIP=y
BR2_PACKAGE_P7ZIP=y
BR2_PACKAGE_P7ZIP_7ZA=y
BR2_PACKAGE_PIGZ=y
BR2_PACKAGE_PIXZ=y
BR2_PACKAGE_UNZIP=y
BR2_PACKAGE_ZIP=y
BR2_PACKAGE_COREMARK=y
BR2_PACKAGE_GDB=y
BR2_PACKAGE_LSOF=y
BR2_PACKAGE_BITWISE=y
BR2_PACKAGE_DOS2UNIX=y
BR2_PACKAGE_FD=y
BR2_PACKAGE_FINDUTILS=y
BR2_PACKAGE_FLEX=y
BR2_PACKAGE_GAWK=y
BR2_PACKAGE_GREP=y
BR2_PACKAGE_JQ=y
BR2_PACKAGE_RIPGREP=y
BR2_PACKAGE_SED=y
BR2_PACKAGE_TIG=y
BR2_PACKAGE_TREE=y
BR2_PACKAGE_YQ=y
BR2_PACKAGE_E2FSPROGS=y
BR2_PACKAGE_SL=y
BR2_PACKAGE_IMAGEMAGICK=y
BR2_PACKAGE_RNG_TOOLS=y
BR2_PACKAGE_RNG_TOOLS_NISTBEACON=y
BR2_PACKAGE_RNG_TOOLS_QRYPT=y
BR2_PACKAGE_LUA=y
BR2_PACKAGE_LUA_READLINE=y
BR2_PACKAGE_LBASE64=y
BR2_PACKAGE_LPTY=y
BR2_PACKAGE_LRANDOM=y
BR2_PACKAGE_LSQLITE3=y
BR2_PACKAGE_LUA_ANSICOLORS=y
BR2_PACKAGE_LUA_ARGON2=y
BR2_PACKAGE_LUA_ARGPARSE=y
BR2_PACKAGE_LUA_BIT32=y
BR2_PACKAGE_LUA_CFFI=y
BR2_PACKAGE_LUA_CJSON=y
BR2_PACKAGE_LUA_CODEGEN=y
BR2_PACKAGE_LUA_CURL=y
BR2_PACKAGE_LUA_DATAFILE=y
BR2_PACKAGE_LUA_HTTP=y
BR2_PACKAGE_LUA_ICONV=y
BR2_PACKAGE_LUA_INOTIFY=y
BR2_PACKAGE_LUA_LGDBM=y
BR2_PACKAGE_LUA_LUNITX=y
BR2_PACKAGE_LUA_LYAML=y
BR2_PACKAGE_LUA_MARKDOWN=y
BR2_PACKAGE_LUA_MESSAGEPACK=y
BR2_PACKAGE_LUA_MQTT=y
BR2_PACKAGE_LUA_STDLIB=y
BR2_PACKAGE_LUA_TESTMORE=y
BR2_PACKAGE_LUA_UBJSON=y
BR2_PACKAGE_LUA_UTF8=y
BR2_PACKAGE_LUA_UUID=y
BR2_PACKAGE_LUA_ZLIB=y
BR2_PACKAGE_LUAEXPAT=y
BR2_PACKAGE_LUAFILESYSTEM=y
BR2_PACKAGE_LUAJSON=y
BR2_PACKAGE_LUASEC=y
BR2_PACKAGE_LUASQL_SQLITE3=y
BR2_PACKAGE_LUASYSLOG=y
BR2_PACKAGE_LUV=y
BR2_PACKAGE_LZLIB=y
BR2_PACKAGE_NODEJS=y
BR2_PACKAGE_NODEJS_NPM=y
BR2_PACKAGE_NODEJS_MODULES_ADDITIONAL="serve@14.2.6"
BR2_PACKAGE_PYTHON3=y
BR2_PACKAGE_PYTHON3_PY_PYC=y
BR2_PACKAGE_PYTHON3_BZIP2=y
BR2_PACKAGE_PYTHON3_CURSES=y
BR2_PACKAGE_PYTHON3_DECIMAL=y
BR2_PACKAGE_PYTHON3_READLINE=y
BR2_PACKAGE_PYTHON3_SSL=y
BR2_PACKAGE_PYTHON3_SQLITE=y
BR2_PACKAGE_PYTHON3_PYEXPAT=y
BR2_PACKAGE_PYTHON3_XZ=y
BR2_PACKAGE_PYTHON3_ZLIB=y
BR2_PACKAGE_PYTHON3_ZSTD=y
BR2_PACKAGE_LIBARCHIVE_BSDTAR=y
BR2_PACKAGE_LIBDEFLATE=y
BR2_PACKAGE_LIBZIP=y
BR2_PACKAGE_LZ4_PROGS=y
BR2_PACKAGE_CA_CERTIFICATES=y
BR2_PACKAGE_GNUTLS=y
BR2_PACKAGE_GNUTLS_OPENSSL=y
BR2_PACKAGE_GNUTLS_TOOLS=y
BR2_PACKAGE_LIBSSH2=y
BR2_PACKAGE_LIBOPENSSL_BIN=y
BR2_PACKAGE_RHASH=y
BR2_PACKAGE_RHASH_BIN=y
BR2_PACKAGE_LIBGIT2=y
BR2_PACKAGE_LIBGIT2_CLI=y
BR2_PACKAGE_LIBCONFIG=y
BR2_PACKAGE_LIBFUSE3=y
BR2_PACKAGE_CJSON=y
BR2_PACKAGE_CJSON_UTILS=y
BR2_PACKAGE_JSON_C=y
BR2_PACKAGE_LIBJSON=y
BR2_PACKAGE_LIBXMLPP=y
BR2_PACKAGE_LIBXMLRPC=y
BR2_PACKAGE_LIBXMLRPC_TOOLS_XMLRPC=y
BR2_PACKAGE_TINYXML2=y
BR2_PACKAGE_LIBCAP_NG=y
BR2_PACKAGE_LIBEV=y
BR2_PACKAGE_LIBEVENT=y
BR2_PACKAGE_ICU=y
BR2_PACKAGE_NCURSES_WCHAR=y
BR2_PACKAGE_NCURSES_TARGET_PROGS=y
BR2_PACKAGE_DROPBEAR=y
BR2_PACKAGE_IPERF3=y
BR2_PACKAGE_IPROUTE2=y
BR2_PACKAGE_LYNX=y
BR2_PACKAGE_NET_TOOLS=y
BR2_PACKAGE_NETCAT=y
BR2_PACKAGE_NGREP=y
BR2_PACKAGE_NMAP=y
BR2_PACKAGE_NMAP_NCAT=y
BR2_PACKAGE_NMAP_NMAP=y
BR2_PACKAGE_OPENSSH=y
BR2_PACKAGE_RSYNC=y
BR2_PACKAGE_SOCAT=y
BR2_PACKAGE_SSHPASS=y
BR2_PACKAGE_WGET=y
BR2_PACKAGE_BASH_COMPLETION=y
BR2_PACKAGE_FILE=y
BR2_PACKAGE_GNUPG=y
BR2_PACKAGE_GNUPG_AES=y
BR2_PACKAGE_GNUPG_RSA=y
BR2_PACKAGE_INOTIFY_TOOLS=y
BR2_PACKAGE_NEOFETCH=y
BR2_PACKAGE_HTOP=y
BR2_PACKAGE_IPRUTILS=y
BR2_PACKAGE_NCDU=y
BR2_PACKAGE_PROCPS_NG=y
BR2_PACKAGE_TAR=y
BR2_PACKAGE_BAT=y
BR2_PACKAGE_NANO=y
BR2_PACKAGE_VIM=y
BR2_TARGET_ROOTFS_TAR_GZIP=y
BR2_PACKAGE_HOST_CMAKE=y
BR2_PACKAGE_HOST_ENVIRONMENT_SETUP=y
BR2_PACKAGE_GHOSTTY_TERMINFO=y
BR2_PACKAGE_ENTER=y
```

## configs/loring_defconfig
```kconfig
BR2_x86_64=y
BR2_TOOLCHAIN_BUILDROOT_VENDOR="loring"
BR2_TOOLCHAIN_BUILDROOT_MUSL=y
BR2_KERNEL_HEADERS_VERSION=y
BR2_DEFAULT_KERNEL_VERSION="4.19.325"
BR2_PACKAGE_HOST_LINUX_HEADERS_CUSTOM_4_19=y
BR2_BINUTILS_VERSION_2_47_X=y
BR2_GCC_VERSION_14_X=y
BR2_TOOLCHAIN_BUILDROOT_CXX=y
BR2_GCC_ENABLE_GRAPHITE=y
BR2_DL_DIR="$(BR2_EXTERNAL_AELIUX_EXTERNAL_PATH)/dl"
BR2_OPTIMIZE_0=y
BR2_PACKAGE_OVERRIDE_FILE="$(BR2_EXTERNAL_AELIUX_EXTERNAL_PATH)/local.mk"
BR2_GLOBAL_PATCH_DIR="$(BR2_EXTERNAL_AELIUX_EXTERNAL_PATH)/patches"
BR2_ROOTFS_DEVICE_CREATION_DYNAMIC_MDEV=y
BR2_ROOTFS_MERGED_USR=y
BR2_SYSTEM_BIN_SH_BASH=y
BR2_SYSTEM_DEFAULT_PATH="/bin:/sbin:/usr/bin:/usr/sbin"
BR2_ROOTFS_OVERLAY="$(BR2_EXTERNAL_AELIUX_EXTERNAL_PATH)/boards/common/overlay"
BR2_ROOTFS_POST_BUILD_SCRIPT="$(BR2_EXTERNAL_AELIUX_EXTERNAL_PATH)/boards/common/post-build.sh"
BR2_LINUX_KERNEL=y
BR2_LINUX_KERNEL_CUSTOM_VERSION=y
BR2_LINUX_KERNEL_CUSTOM_VERSION_VALUE="4.19.325"
BR2_LINUX_KERNEL_USE_CUSTOM_CONFIG=y
BR2_LINUX_KERNEL_CUSTOM_CONFIG_FILE="$(BR2_EXTERNAL_AELIUX_EXTERNAL_PATH)/boards/loring/linux_config"
BR2_PACKAGE_BUSYBOX_CONFIG_FRAGMENT_FILES="$(BR2_EXTERNAL_AELIUX_EXTERNAL_PATH)/boards/common/busybox_config"
BR2_PACKAGE_BUSYBOX_SHOW_OTHERS=y
BR2_PACKAGE_BZIP2=y
BR2_PACKAGE_GZIP=y
BR2_PACKAGE_UNZIP=y
BR2_PACKAGE_XZ=y
BR2_PACKAGE_ZIP=y
BR2_PACKAGE_ZSTD=y
BR2_PACKAGE_KEXEC=y
BR2_PACKAGE_KEXEC_ZLIB=y
BR2_PACKAGE_LSOF=y
BR2_PACKAGE_FINDUTILS=y
BR2_PACKAGE_GREP=y
BR2_PACKAGE_SED=y
BR2_PACKAGE_TREE=y
BR2_PACKAGE_SL=y
BR2_PACKAGE_NCURSES_WCHAR=y
BR2_PACKAGE_NCURSES_TARGET_PROGS=y
BR2_PACKAGE_DROPBEAR=y
# BR2_PACKAGE_IFUPDOWN_SCRIPTS is not set
# BR2_PACKAGE_URANDOM_SCRIPTS is not set
BR2_PACKAGE_BASH_COMPLETION=y
BR2_PACKAGE_PROCPS_NG=y
BR2_PACKAGE_TAR=y
BR2_PACKAGE_UTIL_LINUX=y
BR2_PACKAGE_UTIL_LINUX_LIBBLKID=y
BR2_PACKAGE_UTIL_LINUX_LIBUUID=y
BR2_PACKAGE_LESS=y
BR2_PACKAGE_NANO=y
BR2_TARGET_ROOTFS_CPIO_LZ4=y
BR2_TARGET_ROOTFS_INITRAMFS=y
# BR2_TARGET_ROOTFS_TAR is not set
BR2_PACKAGE_HOST_ENVIRONMENT_SETUP=y
# BR2_PACKAGE_ENTER is not set
```

## package/enter/Config.in
```kconfig
config BR2_PACKAGE_ENTER
	bool "enter"
	default y
	depends on BR2_USE_MMU
	help
	  Static isolated-rootfs launcher with best-effort namespace isolation.

	  Installs /enter in the target rootfs. Copy that binary into
	  another rootfs at <rootfs>/enter and run it: the launcher
	  takes its own parent directory as the rootfs and enters it
	  with whatever isolation the running kernel permits.

	  Optional PID, UTS, and IPC namespaces are enabled when supported.
	  A mount namespace is required. Running as a non-root user requires
	  unprivileged user namespaces to be enabled by the host kernel.
	  Missing OverlayFS, sysfs, and devpts support use documented
	  fallbacks or warnings where possible.

	  The rootfs directory must contain /usr and /tmp. A usable /dev and
	  mounted /proc on the host are required; setup failures are reported as errors.

if BR2_PACKAGE_ENTER

config BR2_PACKAGE_ENTER_RUNTIME_WARNINGS
	bool "Show recoverable runtime warnings"
	default y
	help
	  Show non-fatal runtime warnings for optional features and
	  fallback paths. Errors are always reported. Compiler warning
	  diagnostics remain enabled regardless of this setting.

config BR2_PACKAGE_ENTER_OVERLAY
	bool "Enable OverlayFS writable root"
	default y
	help
	  Provide a writable overlay when the rootfs is read-only.

config BR2_PACKAGE_ENTER_IMAGE_OVERLAY
	bool "ext4 image-backed overlay fallback"
	default y
	depends on BR2_PACKAGE_ENTER_OVERLAY
	help
	  When overlay-on-tmpfs cannot be used (e.g. no xattrs),
	  create an ext4 loop image to back upper/work.

config BR2_PACKAGE_ENTER_MKE2FS_PATH
	string "mke2fs path"
	default "mke2fs"
	depends on BR2_PACKAGE_ENTER_IMAGE_OVERLAY
	help
	  Path to the mke2fs or compatible alternatives. Needed for ext4 image creation.

config BR2_PACKAGE_ENTER_PTY_RELAY
	bool "Private PTY relay"
	default y
	help
	  Give the child its own PTY and relay I/O with SIGWINCH handling.

config BR2_PACKAGE_ENTER_USER_NAMESPACE
	bool "Support user namespace"
	default y
	help
	  Attempt USER namespace if uid != 0

config BR2_PACKAGE_ENTER_PID_NAMESPACE
	bool "Support pid namespace"
	default y

config BR2_PACKAGE_ENTER_UTS_NAMESPACE
	bool "Support uts namespace"
	default y

config BR2_PACKAGE_ENTER_IPC_NAMESPACE
	bool "Support ipc namespace"
	default y

config BR2_PACKAGE_ENTER_OPEN_TREE
	bool "Use open_tree/move_mount to enter root"
	default y
	help
	    This method works on newer kernels and will silently fail on older kernels

config BR2_PACKAGE_ENTER_PIVOT_ROOT
	bool "Use pivot_root to enter root"
	default y
	help
	    pivot_root is quirky, its very likely to not work.

config BR2_PACKAGE_ENTER_MOVE_MOUNT
	bool "Use MS_MOVE + chroot to enter root"
	default y
	help
	    This method works on almost all kernels.

config BR2_PACKAGE_ENTER_CHROOT
	bool "Plain chroot as last resort"
	default n
	help
	    This method has major security flaws, its not recommended at all. use it only if other ones not work.

config BR2_PACKAGE_ENTER_ENSURE_USABLE
    bool
    depends on !BR2_PACKAGE_ENTER_OPEN_TREE && !BR2_PACKAGE_ENTER_PIVOT_ROOT
    default y
    select BR2_PACKAGE_ENTER_MOVE_MOUNT

config BR2_PACKAGE_ENTER_DEFAULT_RESOLVER
	bool "Write default /run/resolv.conf"
	default y

endif
```

## package/ghostty-terminfo/Config.in
```kconfig
config BR2_PACKAGE_GHOSTTY_TERMINFO
    bool "ghostty-terminfo"
    default y
    help
      Installs the xterm-ghostty terminfo entry for the Ghostty terminal emulator.
```

## package/musl-utils/Config.in
```kconfig
config BR2_PACKAGE_MUSL_UTILS
	bool "musl-utils"
	depends on BR2_TOOLCHAIN_USES_MUSL
	depends on !BR2_PACKAGE_GETENT
	help
	  getconf, genent and iconv for musl.

comment "musl-utils is not available because getent is selected"
    depends on BR2_PACKAGE_GETENT
```
